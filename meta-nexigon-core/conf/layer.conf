## meta-nexigon-core/conf/layer.conf
```bitbake
BBPATH .= ":${LAYERDIR}"

BBFILES += "${LAYERDIR}/recipes-*/*/*.bb \
            ${LAYERDIR}/recipes-*/*/*.bbappend"

BBFILE_COLLECTIONS += "meta-nexigon-core"
BBFILE_PATTERN_meta-nexigon-core = "^${LAYERDIR}/"
BBFILE_PRIORITY_meta-nexigon-core = "6"

LAYERDEPENDS_meta-nexigon-core = "core"
LAYERRECOMMENDS_meta-nexigon-core = ""
LAYERSERIES_COMPAT_meta-nexigon-core = "scarthgap"
```

## meta-nexigon-rauc/conf/layer.conf
```bitbake
BBPATH .= ":${LAYERDIR}"

BBFILES += "${LAYERDIR}/recipes-*/*/*.bb \
            ${LAYERDIR}/recipes-*/*/*.bbappend"

BBFILE_COLLECTIONS += "meta-nexigon-rauc"
BBFILE_PATTERN_meta-nexigon-rauc = "^${LAYERDIR}/"
BBFILE_PRIORITY_meta-nexigon-rauc = "8"

LAYERDEPENDS_meta-nexigon-rauc = "core meta-nexigon-core"
LAYERSERIES_COMPAT_meta-nexigon-rauc = "scarthgap"
```

## meta-nexigon-rugix/conf/layer.conf
```bitbake
BBPATH .= ":${LAYERDIR}"

BBFILES += "${LAYERDIR}/recipes-*/*/*.bb \
            ${LAYERDIR}/recipes-*/*/*.bbappend"

BBFILE_COLLECTIONS += "meta-nexigon-rugix"
BBFILE_PATTERN_meta-nexigon-rugix = "^${LAYERDIR}/"
BBFILE_PRIORITY_meta-nexigon-rugix = "6"

LAYERDEPENDS_meta-nexigon-rugix = "core meta-nexigon-core"
LAYERSERIES_COMPAT_meta-nexigon-rugix = "scarthgap"
```
