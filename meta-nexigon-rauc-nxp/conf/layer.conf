## meta-nexigon-rauc-nxp/conf/layer.conf
```bitbake
BBPATH .= ":${LAYERDIR}"

BBFILES += "${LAYERDIR}/recipes-*/*/*.bb \
            ${LAYERDIR}/recipes-*/*/*.bbappend"

BBFILE_COLLECTIONS += "meta-nexigon-rauc-nxp"
BBFILE_PATTERN_meta-nexigon-rauc-nxp = "^${LAYERDIR}/"
BBFILE_PRIORITY_meta-nexigon-rauc-nxp = "9"

LAYERDEPENDS_meta-nexigon-rauc-nxp = "core rauc freescale-layer meta-nexigon-rauc"
LAYERSERIES_COMPAT_meta-nexigon-rauc-nxp = "wrynose"
```
